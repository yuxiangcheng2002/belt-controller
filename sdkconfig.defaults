## sdkconfig.defaults
```kconfig
# BLE via NimBLE
CONFIG_BT_ENABLED=y
CONFIG_BT_NIMBLE_ENABLED=y
CONFIG_BT_NIMBLE_MAX_CONNECTIONS=1

# Power management — enables light sleep during FreeRTOS idle
# (ESP32-S3 BT controller sleeps automatically when PM is enabled)
CONFIG_PM_ENABLE=y
CONFIG_FREERTOS_USE_TICKLESS_IDLE=y

# Persist BLE bonding in NVS so it survives deep sleep / reboot
CONFIG_BT_NIMBLE_NVS_PERSIST=y
```
